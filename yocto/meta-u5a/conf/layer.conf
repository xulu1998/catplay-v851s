## yocto/meta-u5a/conf/layer.conf
```bitbake
BBPATH .= ":${LAYERDIR}"
BBFILES += "${LAYERDIR}/recipes-*/*/*.bb ${LAYERDIR}/recipes-*/*/*.bbappend"

BBFILE_COLLECTIONS += "u5a"
BBFILE_PATTERN_u5a = "^${LAYERDIR}/"
BBFILE_PRIORITY_u5a = "20"
LAYERDEPENDS_u5a = "core catplay carplay"
LAYERSERIES_COMPAT_u5a = "wrynose"
```
